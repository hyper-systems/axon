## CMakeLists.txt
```
#
# Copyright (c) 2021 Hyper Collective LTD
#
cmake_minimum_required(VERSION 3.13.1)

set(PROJECT_ROOT_DIR ${CMAKE_CURRENT_SOURCE_DIR}/../)

# set custom `boards` directory
set(BOARD_ROOT ${PROJECT_ROOT_DIR}/)

# add extenal libs modules
set(ZEPHYR_EXTRA_MODULES
    # add Hyper Drivers module
    ${PROJECT_ROOT_DIR}/drivers
    # add external libs module
    ${PROJECT_ROOT_DIR}/lib)

# Find Zephyr. This also loads Zephyr's build system.
find_package(Zephyr REQUIRED HINTS $ENV{ZEPHYR_BASE})
project(axon)

file(GLOB SRC_FILES ${PROJECT_SOURCE_DIR}/src/*.c)
target_sources(app PRIVATE ${SRC_FILES})
target_include_directories(app PUBLIC ${PROJECT_SOURCE_DIR}/src/)

add_subdirectory(${PROJECT_SOURCE_DIR}/hyper_device)

# add HYPER_FIRMWARE_VER macro
execute_process(
  COMMAND ${PROJECT_ROOT_DIR}/utils/get_commit_hash.sh
  WORKING_DIRECTORY ${CMAKE_CURRENT_LIST_DIR}
  OUTPUT_VARIABLE GIT_HASH
  OUTPUT_STRIP_TRAILING_WHITESPACE)
target_compile_definitions(app PRIVATE -DHYPER_FIRMWARE_VER="${GIT_HASH}")
```

## Kconfig
```
#
# Copyright (c) 2021 Hyper Collective LTD
#

menu "Zephyr Kernel"
source "Kconfig.zephyr"
endmenu

module = MAIN
module-str = Axon Firmware
source "${ZEPHYR_BASE}/subsys/logging/Kconfig.template.log_config"

module = COAP_CLIENT
module-str = CoAP client
source "${ZEPHYR_BASE}/subsys/logging/Kconfig.template.log_config"

module = OT_UTILS
module-str = OpenThread utilities
source "${ZEPHYR_BASE}/subsys/logging/Kconfig.template.log_config"

module = BLE_UTILS
module-str = Bluetooth connection utilities
source "${ZEPHYR_BASE}/subsys/logging/Kconfig.template.log_config"

module = EXTENSION_UTILS
module-str = Hyper Extension utilities
source "${ZEPHYR_BASE}/subsys/logging/Kconfig.template.log_config"

menu "Hyper Devices support"
rsource "hyper_device/Kconfig"
endmenu
```

## prj.conf
```kconfig
#
# Copyright (c) 2021 Hyper Collective LTD
#

# Enable CoAP utils and CoAP protocol
CONFIG_COAP_UTILS=y

# Network sockets
CONFIG_NET_SOCKETS=y
CONFIG_NET_SOCKETS_POSIX_NAMES=y
CONFIG_NET_SOCKETS_POLL_MAX=4

# This sample makes use of system workqueue and requires increased stack size.
CONFIG_SYSTEM_WORKQUEUE_STACK_SIZE=4096

# Network settings
CONFIG_NETWORKING=y
CONFIG_NET_SOCKETS_POSIX_NAMES=y
CONFIG_NET_CONNECTION_MANAGER=y
CONFIG_NET_BUF_USER_DATA_SIZE=24
CONFIG_NET_CONFIG_SETTINGS=y

# Enable minimal logging implementation to decrease memory footprint
CONFIG_LOG=y
CONFIG_LOG_MODE_MINIMAL=y
CONFIG_PRINTK_SYNC=y

CONFIG_PWM=y
CONFIG_LED=y
CONFIG_LED_PWM=y
```

## overlay-dev.conf
```kconfig
# Configure logging setting
CONFIG_NEWLIB_LIBC_FLOAT_PRINTF=y
CONFIG_MAIN_LOG_LEVEL_INF=y
CONFIG_COAP_UTILS_LOG_LEVEL_DBG=y
CONFIG_COAP_LOG_LEVEL_DBG=y
CONFIG_COAP_CLIENT_LOG_LEVEL_DBG=y
CONFIG_EXTENSION_UTILS_LOG_LEVEL_DBG=y
CONFIG_OT_UTILS_LOG_LEVEL_DBG=y
CONFIG_OPENTHREAD_LOG_LEVEL_WARN=y
CONFIG_I2C_LOG_LEVEL_OFF=y

# Network shell
CONFIG_NET_SHELL=y
CONFIG_SHELL_ARGC_MAX=26
CONFIG_SHELL_CMD_BUFF_SIZE=416
```

## overlay-nrf5.conf
```kconfig
# nRF board library
CONFIG_DK_LIBRARY=y
```

## overlay-prod.conf
```kconfig
CONFIG_NEWLIB_LIBC_FLOAT_PRINTF=n
CONFIG_MAIN_LOG_LEVEL_OFF=y
CONFIG_COAP_UTILS_LOG_LEVEL_OFF=y
CONFIG_COAP_LOG_LEVEL_OFF=y
CONFIG_COAP_CLIENT_LOG_LEVEL_OFF=y
CONFIG_EXTENSION_UTILS_LOG_LEVEL_OFF=y
CONFIG_OT_UTILS_LOG_LEVEL_OFF=y
CONFIG_OPENTHREAD_LOG_LEVEL_CRIT=y
CONFIG_I2C_LOG_LEVEL_OFF=y


CONFIG_NET_SHELL=n
CONFIG_MCUMGR_CMD_SHELL_MGMT=n

# disable logging
CONFIG_LOG=y
```

## overlay-rtt.conf
```kconfig
# choose RTT console instead of UART
CONFIG_UART_CONSOLE=n
CONFIG_USE_SEGGER_RTT=y
CONFIG_RTT_CONSOLE=y
CONFIG_SHELL_BACKEND_RTT=y
```

## overlay-smp.conf
```kconfig
## SMP
# Enable mcumgr.
CONFIG_MCUMGR=y


# Ensure an MCUboot-compatible binary is generated.
CONFIG_BOOTLOADER_MCUBOOT=y

# Enable flash operations.
CONFIG_FLASH=y

# Required by the `taskstat` command.
CONFIG_THREAD_MONITOR=y

# Enable statistics and statistic names.
# CONFIG_MCUMGR_CMD_STAT_MGMT is not set
# CONFIG_STATS is not set
# CONFIG_STATS_NAMES is not set

# Enable most core commands.
CONFIG_MCUMGR_CMD_IMG_MGMT=y
CONFIG_MCUMGR_CMD_OS_MGMT=y
CONFIG_MCUMGR_CMD_SHELL_MGMT=y
# CONFIG_MCUMGR_CMD_FS_MGMT is not set
CONFIG_MCUMGR_BUF_COUNT=6

# Enable the UDP mcumgr transports.
CONFIG_MCUMGR_SMP_UDP=y
CONFIG_MCUMGR_SMP_UDP_IPV6=y
```

## boards/axon_v0_2_nrf52840.overlay
```dts
/*
 * Copyright (c) 2021 Hyper Collective LTD
 */

/ {
	/*
	* In some default configurations within the nRF Connect SDK,
	* e.g. on nRF52840, the chosen zephyr,entropy node is &cryptocell.
	* This devicetree overlay ensures that default is overridden wherever it
	* is set, as this application uses the RNG node for entropy exclusively.
	*/
	chosen {
		zephyr,entropy = &rng;
	};
};
```

## boards/axon_v1_3_0_nrf52840.overlay
```dts
/*
 * Copyright (c) 2021 Hyper Collective LTD
 */

 / {
	/*
	* In some default configurations within the nRF Connect SDK,
	* e.g. on nRF52840, the chosen zephyr,entropy node is &cryptocell.
	* This devicetree overlay ensures that default is overridden wherever it
	* is set, as this application uses the RNG node for entropy exclusively.
	*/
	chosen {
		zephyr,entropy = &rng;
	};
};
```

## src/main.c
```c
/*
 * Copyright (c) 2021 Hyper Collective LTD
 */
#include <zephyr.h>
#include <logging/log.h>

#if defined(CONFIG_MCUMGR)
#include "smp.h"
#endif
#ifdef CONFIG_BOOTLOADER_MCUBOOT
#include <dfu/mcuboot.h>
#endif
#include <ram_pwrdn.h>

#include "axon.h"
#include "controller.h"

LOG_MODULE_REGISTER(main, CONFIG_MAIN_LOG_LEVEL);

void main(void)
{
	int ret;

	if (IS_ENABLED(CONFIG_RAM_POWER_DOWN_LIBRARY))
	{
		power_down_unused_ram();
	}

	// Hardware related inits
	ret = axon_init();
	if (ret)
	{
		LOG_ERR("axon_init() failed with exit code: %d\n", ret);
		k_panic();
	}

	// detect hyper devices and init them
	ret = hyper_controller_init();
	if (ret)
	{
		LOG_ERR("hyper_controller_init() failed with exit code: %d\n", ret);
	}

#if defined(CONFIG_MCUMGR)
	smp_loop();
#endif

	LOG_INF("Axon main() initialized!");
}
```

## src/axon.c
```c
#include <zephyr.h>
#include <kernel.h>
#include <logging/log.h>
#include <sys/printk.h>
#include <sys/reboot.h>
#include <device.h>
#include <devicetree.h>
#include <drivers/sensor.h>
#include <drivers/i2c.h>
#include <drivers/gpio.h>
#include <drivers/led.h>
#include <dk_buttons_and_leds.h>

#include "driver_utils.h"
#include "misc_utils.h"
#include "axon.h"

LOG_MODULE_REGISTER(axon_device, CONFIG_MAIN_LOG_LEVEL);

#define BUTTON1 0
#define BUTTON1_MSK BIT(BUTTON1)

#define buttons_init(...) dk_buttons_init(__VA_ARGS__)

#if DT_NODE_HAS_STATUS(DT_INST(0, pwm_leds), okay)
#define LED_PWM_NODE_ID DT_INST(0, pwm_leds)
#define LED_PWM_DEV_NAME DEVICE_DT_NAME(LED_PWM_NODE_ID)
#else
#error "No LED PWM device found"
#endif

#define LED_PWM_LABEL(led_node_id) DT_PROP_OR(led_node_id, label, NULL),

#define PWM_LED_0 0
#define PWM_LED_1 1

const struct device *led_pwm;

struct device *gpio_dev0;
struct device *gpio_dev1;

#ifdef CONFIG_BOARD_AXON_V0_2_NRF52840
#define RESET_MUX_GPIO_GROUP gpio_dev0
#define RESET_MUX_GPIO_PIN 8
#define ON_VCC_EX_GPIO_GROUP gpio_dev1
#define ON_VCC_EX_GPIO_PIN 13
#endif
#define CON0_GPIO_GROUP gpio_dev1
#define CON0_GPIO_PIN 11
#define CON1_GPIO_GROUP gpio_dev1
#define CON1_GPIO_PIN 10
#define CON2_GPIO_GROUP gpio_dev0
#define CON2_GPIO_PIN 3
#define CON3_GPIO_GROUP gpio_dev0
#define CON3_GPIO_PIN 28

#define BME280 DT_INST(0, bosch_bme280)
#define SHT3XD DT_INST(0, sensirion_sht3xd)

#if DT_NODE_HAS_STATUS(BME280, okay)
#define ENV_SENSORS_LABEL DT_LABEL(BME280)
#elif DT_NODE_HAS_STATUS(SHT3XD, okay)
#define ENV_SENSORS_LABEL DT_LABEL(SHT3XD)
#else
#error Your devicetree has no enabled nodes with compatible "bosch,bme280" or "sensirion,sht3xd"
#define ENV_SENSORS_LABEL "<none>"
#endif

#define OPT3001 DT_INST(0, ti_opt3001)
#define VEML7700 DT_INST(0, vishay_veml7700)

#if DT_NODE_HAS_STATUS(OPT3001, okay)
#define ALS_SENSOR_LABEL DT_LABEL(OPT3001)
#elif DT_NODE_HAS_STATUS(VEML7700, okay)
#include "veml7700.h"
#define ALS_SENSOR_LABEL DT_LABEL(VEML7700)
#else
#error Your devicetree has no enabled nodes with compatible "ti,opt3001" or "vishay,veml7700"
#define ALS_SENSOR_LABEL "<none>"
#endif

typedef struct __attribute((packed))
{
	float temp;
#ifdef ENVIRONMENT_SENSOR_HAS_PRESSURE
	float press;
#endif
	float humid;
} environment_vals_t;

static struct device *env_sensors;
static struct device *als_sensor;
static environment_vals_t environment_sensor_vals = {0};
static float als_val = 0;

struct device *ext_i2c_bus_dev;

static uint16_t axon_publish_interval;

static void (*axon_publish_interval_cb)(void) = NULL;

float axon_temp_get(void)
{
	return environment_sensor_vals.temp;
}

#ifdef ENVIRONMENT_SENSOR_HAS_PRESSURE
float axon_press_get(void)
{
	return environment_sensor_vals.press;
}
#endif

float axon_humid_get(void)
{
	return environment_sensor_vals.humid;
}

float axon_luminosity_get(void)
{
	return als_val;
}

static int axon_env_sensor_sample_fetch(void)
{
	struct sensor_value temp, humidity;

	if (env_sensors != NULL)
	{
		sensor_sample_fetch(env_sensors);
		sensor_channel_get(env_sensors, SENSOR_CHAN_AMBIENT_TEMP, &temp);
		sensor_channel_get(env_sensors, SENSOR_CHAN_HUMIDITY, &humidity);
#ifdef ENVIRONMENT_SENSOR_HAS_PRESSURE
		struct sensor_value press;
		sensor_channel_get(env_sensors, SENSOR_CHAN_PRESS, &press);

		LOG_INF("temp: %d.%06d; press: %d.%06d; humidity: %d.%06d;\n",
			temp.val1, temp.val2, press.val1, press.val2,
			humidity.val1, humidity.val2);

		environment_sensor_vals.temp = temp.val1 + ((float)temp.val2 / 1000000);
		environment_sensor_vals.press = press.val1 + ((float)press.val2 / 1000000);
		environment_sensor_vals.humid = humidity.val1 + ((float)humidity.val2 / 1000000);

		printk("temp: %f; press: %f; humidity: %f;\n",
		       environment_sensor_vals.temp, environment_sensor_vals.press, environment_sensor_vals.humid);
#else
		LOG_INF("temp: %d.%06d; humidity: %d.%06d;\n",
			temp.val1, temp.val2, humidity.val1, humidity.val2);

		environment_sensor_vals.temp = temp.val1 + ((float)temp.val2 / 1000000);
		environment_sensor_vals.humid = humidity.val1 + ((float)humidity.val2 / 1000000);

		printk("temp: %f; humidity: %f;\n",
		       environment_sensor_vals.temp, environment_sensor_vals.humid);
#endif

		return 0;
	}
	else
	{
		return 1;
	}
}

static int axon_als_sample_fetch(void)
{
	struct sensor_value luminosity;
	if (als_sensor != NULL)
	{
		sensor_sample_fetch(als_sensor);
		sensor_channel_get(als_sensor, SENSOR_CHAN_LIGHT, &luminosity);
		LOG_INF("luminosity: %d.%06d;\n", luminosity.val1, luminosity.val2);
		als_val = luminosity.val1 + ((float)luminosity.val2 / 1000000);

		printk("luminosity: %f;\n", als_val);

		return 0;
	}
	else
	{
		return 1;
	}
}

int axon_sensors_sample_fetch(void)
{
	int ret;
	ret = axon_env_sensor_sample_fetch();
	if (ret)
	{
		return ret;
	}
	ret = axon_als_sample_fetch();
	if (ret)
	{
		return ret;
	}

	return ret;
}

void axon_macaddr_get(uint8_t *macaddr)
{
	hyper_macaddr_get(macaddr);
}

int64_t axon_uptime_get(void)
{
	return k_uptime_get();
}

int hyper_extension_bus_i2c_write(const uint8_t *buf, uint32_t num_bytes, uint16_t addr)
{
	int ret = i2c_write(ext_i2c_bus_dev, buf, num_bytes, addr);
	if (ret == -EBUSY)
	{
		LOG_ERR("i2c returned -EBUSY (-16), panicing...");
		k_panic();
	}
	return ret;
}

int hyper_extension_bus_i2c_read(uint8_t *buf, uint32_t num_bytes, uint16_t addr)
{
	int ret = i2c_read(ext_i2c_bus_dev, buf, num_bytes, addr);
	if (ret == -EBUSY)
	{
		LOG_ERR("i2c returned -EBUSY (-16), panicing...");
		k_panic();
	}
	return ret;
}

int hyper_extension_bus_i2c_write_read(uint16_t addr, const void *write_buf, size_t num_write,
				       void *read_buf, size_t num_read)
{
	int ret = i2c_write_read(ext_i2c_bus_dev, addr, write_buf, num_write, read_buf, num_read);
	if (ret == -EBUSY)
	{
		LOG_ERR("i2c returned -EBUSY (-16), panicing...");
		k_panic();
	}
	return ret;
}

int hyper_extension_bus_i2c_burst_read(uint16_t dev_addr, uint8_t start_addr, uint8_t *buf,
				       uint32_t num_bytes)
{
	int ret = i2c_burst_read(ext_i2c_bus_dev, dev_addr, start_addr, buf, num_bytes);
	if (ret == -EBUSY)
	{
		LOG_ERR("i2c returned -EBUSY (-16), panicing...");
		k_panic();
	}
	return ret;
}

int hyper_extension_bus_i2c_reg_read_byte(uint16_t dev_addr, uint8_t reg_addr, uint8_t *value)
{
	int ret = i2c_reg_read_byte(ext_i2c_bus_dev, dev_addr, reg_addr, value);
	if (ret == -EBUSY)
	{
		LOG_ERR("i2c returned -EBUSY (-16), panicing...");
		k_panic();
	}
	return ret;
}

int hyper_extension_bus_i2c_reg_write_byte(uint16_t dev_addr, uint8_t reg_addr, uint8_t value)
{
	int ret = i2c_reg_write_byte(ext_i2c_bus_dev, dev_addr, reg_addr, value);
	if (ret == -EBUSY)
	{
		LOG_ERR("i2c returned -EBUSY (-16), panicing...");
		k_panic();
	}
	return ret;
}

int hyper_extension_eeprom_read(uint8_t *buff, uint8_t len, uint8_t pointer, uint16_t i2c_addr)
{
	int ret = i2c_write(ext_i2c_bus_dev, &pointer, 1, i2c_addr);
	if (ret != 0)
	{
		return ret;
	}
	// i2c_addr + 1 for read address
	return i2c_read(ext_i2c_bus_dev, buff, len, i2c_addr + 1);
}

__unused static int hyper_extension_eeprom_write(const uint8_t *buff, uint8_t len, uint8_t pointer, uint16_t i2c_addr)
{
	// add pointer to buffer
	uint8_t buff_pointer[len + 1];
	buff_pointer[0] = pointer;
	memcpy(&buff_pointer[1], buff, len);
	return i2c_write(ext_i2c_bus_dev, buff_pointer, sizeof(buff_pointer), i2c_addr + 1);
}

// Read EUI-48 from extension
int hyper_extension_eui48_read(uint8_t *data)
{
	return hyper_extension_eeprom_read(data, 6, 0xFA, EEPROM_24AA02E48_I2C_ADDR);
}

int hyper_extension_class_id_read(uint32_t *data)
{
	return hyper_extension_eeprom_read((uint8_t *)data, sizeof(uint32_t), 0x00,
					   EEPROM_24AA02E48_I2C_ADDR);
}

int hyper_extension_data_read(uint8_t *data, uint8_t len, uint8_t offset)
{
	return hyper_extension_eeprom_read(data, len,
					   HYPER_EXTENSION_DATA_EEPROM_OFFSET + offset,
					   EEPROM_24AA02E48_I2C_ADDR);
}

// checks if extension is connected by probing its EEPROM
hyper_extension_type_t hyper_extension_get_type()
{
	if (hyper_i2c_device_is_present(ext_i2c_bus_dev, EEPROM_24AA02E48_I2C_ADDR))
	{
		return HYPER_EXTENSION_EEPROM;
	}

	if (hyper_i2c_device_is_present(ext_i2c_bus_dev, HYPER_EXTENSION_MCU_I2C_ADDR))
	{
		return HYPER_EXTENSION_MCU;
	}

	return HYPER_EXTENSION_NOT_CONNECTED;
}

static void on_button_changed(uint32_t button_state, uint32_t has_changed)
{
	uint32_t buttons = button_state & has_changed;

	if (buttons & BUTTON1_MSK)
	{
		axon_publish_interval_cb();
		axon_publish_interval_timer_reset();
	}
}

static int axon_buttons_init()
{
	return buttons_init(on_button_changed);
}

static int axon_sensors_init(void)
{
	int retval = 0;
	if (hyper_dev_init(&env_sensors, ENV_SENSORS_LABEL))
#ifdef CONFIG_BOARD_AXON_V0_2_NRF52840
		retval = 1;
#else
		retval = 0;
#endif

	if (hyper_dev_init(&als_sensor, ALS_SENSOR_LABEL))
#ifdef CONFIG_BOARD_AXON_V0_2_NRF52840
		retval = 1;
#else
		retval = 0;
#endif

	return retval;
}

void axon_publish_interval_callback_set(void (*publish_interval_cb)(void))
{
	axon_publish_interval_cb = publish_interval_cb;
}

static void axon_publish_interval_work_handler(struct k_work *work)
{
	axon_publish_interval_cb();
}

K_WORK_DEFINE(axon_publish_interval_work, axon_publish_interval_work_handler);

static void axon_publish_interval_timer_handler(struct k_timer *dummy)
{
	k_work_submit(&axon_publish_interval_work);
}

K_TIMER_DEFINE(axon_publish_interval_timer, axon_publish_interval_timer_handler, NULL);

void axon_publish_interval_set(uint16_t interval_sec)
{
	axon_publish_interval = interval_sec;
	k_timer_stop(&axon_publish_interval_timer);
	k_timer_start(&axon_publish_interval_timer, K_SECONDS(interval_sec), K_SECONDS(interval_sec));
}

uint16_t axon_publish_interval_get(void)
{
	return axon_publish_interval;
}

void axon_publish_interval_timer_reset(void)
{
	k_timer_stop(&axon_publish_interval_timer);
	k_timer_start(&axon_publish_interval_timer, K_SECONDS(axon_publish_interval),
		      K_SECONDS(axon_publish_interval));
}

static int axon_led_init()
{
	int ret = 0;

	led_pwm = device_get_binding(LED_PWM_DEV_NAME);
	if (led_pwm)
	{
		LOG_INF("Found device %s", LED_PWM_DEV_NAME);
	}
	else
	{
		LOG_ERR("Device %s not found", LED_PWM_DEV_NAME);
		return -1;
	}

	return ret;
}

int axon_led_0_set_blink(uint32_t delay_on, uint32_t delay_off)
{
	int ret = 0;
	ret = led_blink(led_pwm, PWM_LED_0, delay_on, delay_off);
	if (ret < 0)
	{
		LOG_ERR("led_blink() failed with exit code: %d\n", ret);
		return ret;
	}

	return ret;
}

int axon_led_0_set_on(uint8_t brightness)
{
	int ret = 0;

	ret = led_on(led_pwm, PWM_LED_0);
	if (ret < 0)
	{
		LOG_ERR("led_on() failed with exit code: %d\n", ret);
		return ret;
	}

	ret = led_set_brightness(led_pwm, PWM_LED_0, brightness);
	if (ret < 0)
	{
		LOG_ERR("led_on() failed with exit code: %d\n", ret);
		return ret;
	}

	return ret;
}

int axon_led_0_set_off()
{
	int ret = 0;

	ret = led_off(led_pwm, PWM_LED_0);
	if (ret < 0)
	{
		LOG_ERR("led_off() failed with exit code: %d\n", ret);
		return ret;
	}

	return ret;
}

#if defined(CONFIG_BOARD_AXON_V2_0_NRF52840)
int axon_led_1_set_blink(uint32_t delay_on, uint32_t delay_off)
{
	int ret = 0;
	ret = led_blink(led_pwm, PWM_LED_1, delay_on, delay_off);
	if (ret < 0)
	{
		LOG_ERR("led_blink() failed with exit code: %d\n", ret);
		return ret;
	}

	return ret;
}

int axon_led_1_set_on(uint8_t brightness)
{
	int ret = 0;

	ret = led_on(led_pwm, PWM_LED_1);
	if (ret < 0)
	{
		LOG_ERR("led_on() failed with exit code: %d\n", ret);
		return ret;
	}

	ret = led_set_brightness(led_pwm, PWM_LED_1, brightness);
	if (ret < 0)
	{
		LOG_ERR("led_on() failed with exit code: %d\n", ret);
		return ret;
	}

	return ret;
}

int axon_led_1_set_off()
{
	int ret = 0;

	ret = led_off(led_pwm, PWM_LED_1);
	if (ret < 0)
	{
		LOG_ERR("led_off() failed with exit code: %d\n", ret);
		return ret;
	}

	return ret;
}
#endif

#ifndef CONFIG_BOARD_AXON_V0_2_NRF52840
__unused
#endif
    static int
    axon_gpio_write(const struct device *gpio_dev, gpio_pin_t gpio_pin, uint8_t value)
{
	int err = gpio_pin_set_raw(gpio_dev, gpio_pin, value);
	if (err)
	{
		LOG_ERR("Cannot write %s, pin: %u, err: %d", gpio_dev->name, gpio_pin, err);
		return 1;
	}

	return 0;
}

__unused static int axon_gpio_read(const struct device *gpio_dev, gpio_pin_t gpio_pin)
{
	int val = gpio_pin_get_raw(gpio_dev, gpio_pin);
	if (val < 0)
	{
		LOG_ERR("Cannot read gpio %s, pin: %u, err: %d", gpio_dev->name, gpio_pin, val);
		return 1;
	}
	LOG_ERR("read gpio %s, pin: %u, val: %d", gpio_dev->name, gpio_pin, val);

	return val;
}

#ifdef CONFIG_BOARD_AXON_V0_2_NRF52840
static int axon_vcc_ex_set_on()
{
	if (axon_gpio_write(ON_VCC_EX_GPIO_GROUP, ON_VCC_EX_GPIO_PIN, 0) != 0)
	{
		LOG_ERR("Failed turn on VCC_EX!");
		return 1;
	}

	return 0;
}

static int axon_vcc_ex_set_off()
{
	if (axon_gpio_write(ON_VCC_EX_GPIO_GROUP, ON_VCC_EX_GPIO_PIN, 1) != 0)
	{
		LOG_ERR("Failed turn off VCC_EX!");
		return 1;
	}
	return 0;
}

static int axon_vcc_mux_set_on()
{
	if (axon_gpio_write(RESET_MUX_GPIO_GROUP, RESET_MUX_GPIO_PIN, 1) != 0)
	{
		LOG_ERR("Failed turn set RESET_MUX to High!");
		return 1;
	}
	return 0;
}

static int axon_vcc_mux_set_off()
{
	if (axon_gpio_write(RESET_MUX_GPIO_GROUP, RESET_MUX_GPIO_PIN, 0) != 0)
	{
		LOG_ERR("Failed turn set RESET_MUX to Low!");
		return 1;
	}
	return 0;
}
#endif

void axon_trigger_cold_reboot(void)
{
	LOG_WRN("Triggering: FORCED COLD REBOOT\n");
#ifdef CONFIG_BOARD_AXON_V0_2_NRF52840
	axon_vcc_ex_set_off();
	axon_vcc_mux_set_off();
#endif
	sys_reboot(SYS_REBOOT_COLD);
}

void hyper_extension_bus_mux_reset(void)
{
	uint8_t mux_write = 0b00000000;
	if (hyper_extension_bus_i2c_write(&mux_write, 1, 0x70))
	{
		LOG_ERR("Failed to reset mux ports! Panicing...");
		k_panic();
	};
}

void hyper_extension_bus_mux_port_select(uint8_t port)
{
	uint8_t mux_write = 0;
	mux_write = 0 | 1 << (port - 1);
	if (hyper_extension_bus_i2c_write(&mux_write, 1, 0x70))
	{
		LOG_ERR("Failed to select mux port %d! Panicing...", port);
		k_panic();
	};
}

hyper_extension_bus_mux_state_t hyper_extension_bus_mux_state_get(void)
{
	uint8_t mux_read = 0;
	hyper_extension_bus_i2c_read(&mux_read, 1, 0x70);
	return mux_read;
}

void hyper_extension_bus_mux_state_print(hyper_extension_bus_mux_state_t mux_read)
{
	LOG_DBG("===================================================");
	LOG_DBG("mux_read: " BYTE_TO_BINARY_PATTERN "\n", BYTE_TO_BINARY(mux_read));
	LOG_DBG("===================================================");
}

int axon_gpio_init(void)
{
	int ret = 0;
	ret = hyper_dev_init(&gpio_dev0, "GPIO_0");
	if (ret < 0)
	{
		LOG_ERR("hyper_dev_init() for GPIO_0 failed with exit code: %d\n", ret);
		return ret;
	}
	ret = hyper_dev_init(&gpio_dev1, "GPIO_1");
	if (ret < 0)
	{
		LOG_ERR("hyper_dev_init() for GPIO_1 failed with exit code: %d\n", ret);
		return ret;
	}

#ifdef CONFIG_BOARD_AXON_V0_2_NRF52840
	// ON_VCC_EX PIN
	ret = gpio_pin_configure(ON_VCC_EX_GPIO_GROUP, ON_VCC_EX_GPIO_PIN, GPIO_OUTPUT);
	if (ret < 0)
	{
		LOG_ERR("gpio_pin_configure() for ON_VCC_EX_GPIO_PIN failed with exit code: %d\n", ret);
		return ret;
	}

	// RESET_MUX pin
	ret = gpio_pin_configure(RESET_MUX_GPIO_GROUP, RESET_MUX_GPIO_PIN, GPIO_OUTPUT);
	if (ret < 0)
	{
		LOG_ERR("gpio_pin_configure() for RESET_MUX_GPIO_PIN failed with exit code: %d\n", ret);
		return ret;
	}

	// CON pins
	gpio_pin_configure(CON0_GPIO_GROUP, CON0_GPIO_PIN, GPIO_INPUT);
	gpio_pin_configure(CON1_GPIO_GROUP, CON1_GPIO_PIN, GPIO_INPUT);
	gpio_pin_configure(CON2_GPIO_GROUP, CON2_GPIO_PIN, GPIO_INPUT);
	gpio_pin_configure(CON3_GPIO_GROUP, CON3_GPIO_PIN, GPIO_INPUT);
#endif

	return 0;
}

int hyper_extension_bus_init(void)
{
#ifdef CONFIG_BOARD_AXON_V0_2_NRF52840
	axon_vcc_ex_set_on();
	axon_vcc_mux_set_on();
#endif
	if (hyper_dev_init(&ext_i2c_bus_dev, "I2C_1"))
		return 1;

#ifdef CONFIG_BOARD_AXON_V0_2_NRF52840
	hyper_extension_bus_mux_reset();
	hyper_extension_bus_mux_port_select(4);
	hyper_extension_bus_mux_state_print(hyper_extension_bus_mux_state_get());
#endif

	return 0;
}

int axon_init(void)
{
	int ret = axon_buttons_init();
	if (ret)
	{
		LOG_ERR("axon_buttons_init() failed with exit code: %d\n", ret);
		return ret;
	}

	// init GPIOs before the hyper_extension_bus
	ret = axon_gpio_init();
	if (ret)
	{
		LOG_ERR("axon_gpio_init() failed with exit code: %d\n", ret);
		return ret;
	}

	// init extension bus
	ret = hyper_extension_bus_init();
	if (ret)
	{
		LOG_ERR("hyper_extension_bus_init() failed with exit code: %d\n", ret);
		return ret;
	}

	// init LED
	ret = axon_led_init();
	if (ret)
	{
		LOG_ERR("axon_led_init() failed with exit code: %d\n", ret);
		return ret;
	}

	ret = axon_sensors_init();
	if (ret)
	{
		LOG_ERR("axon_sensors_init() failed with exit code: %d\n", ret);
		return ret;
	}

	// LED Blink test patterns
	// while (true)
	// {
	// axon_led_0_set_blink(130, 130);
	// k_sleep(K_MSEC(5000));
	// axon_led_0_set_blink(30, 130);
	// k_sleep(K_MSEC(5000));
	// axon_led_0_set_blink(130, 30);
	// k_sleep(K_MSEC(5000));
	// axon_led_0_set_blink(40, 40);
	// k_sleep(K_MSEC(5000));
	// axon_led_0_set_blink(10, 130);
	// k_sleep(K_MSEC(5000));
	// axon_led_0_set_off();
	// k_sleep(K_MSEC(5000));
	// axon_led_0_set_on();
	// k_sleep(K_MSEC(5000));
	// }

	return ret;
}
```

## src/axon.h
```c
#ifndef __AXON_DEVICE_H__
#define __AXON_DEVICE_H__
#include <stdint.h>
#include <stdbool.h>

#define EEPROM_24AA02E48_I2C_ADDR 0x50
#define HYPER_EXTENSION_MCU_I2C_ADDR 0x05

#define HYPER_EXTENSION_DATA_EEPROM_OFFSET 0x14

#define AXON_PUBLISH_INTERVAL_DEFAULT_SEC 30

typedef enum
{
	HYPER_EXTENSION_NOT_CONNECTED,
	HYPER_EXTENSION_EEPROM,
	HYPER_EXTENSION_MCU
} hyper_extension_type_t;

#if defined(CONFIG_BOARD_AXON_V1_0_NRF52840) || defined(CONFIG_BOARD_AXON_V0_2_NRF52840) || defined(CONFIG_BOARD_AXON_V2_0_NRF52840)
#define ENVIRONMENT_SENSOR_HAS_PRESSURE
#endif

int hyper_extension_bus_init(void);
int hyper_extension_eeprom_read(uint8_t *buff, uint8_t len, uint8_t pointer, uint16_t i2c_addr);
int hyper_extension_eui48_read(uint8_t *data);
int hyper_extension_class_id_read(uint32_t *data);
int hyper_extension_data_read(uint8_t *data, uint8_t len, uint8_t offset);
hyper_extension_type_t hyper_extension_get_type(void);

int hyper_extension_bus_i2c_write(const uint8_t *buf, uint32_t num_bytes, uint16_t addr);
int hyper_extension_bus_i2c_read(uint8_t *buf, uint32_t num_bytes, uint16_t addr);
int hyper_extension_bus_i2c_write_read(uint16_t addr, const void *write_buf, size_t num_write,
				       void *read_buf, size_t num_read);
int hyper_extension_bus_i2c_burst_read(uint16_t dev_addr, uint8_t start_addr, uint8_t *buf,
				       uint32_t num_bytes);
int hyper_extension_bus_i2c_reg_read_byte(uint16_t dev_addr, uint8_t reg_addr, uint8_t *value);
int hyper_extension_bus_i2c_reg_write_byte(uint16_t dev_addr, uint8_t reg_addr, uint8_t value);

float axon_temp_get(void);
#ifdef ENVIRONMENT_SENSOR_HAS_PRESSURE
float axon_press_get(void);
#endif
float axon_humid_get(void);
float axon_luminosity_get(void);
int axon_sensors_sample_fetch(void);
void axon_macaddr_get(uint8_t *macaddr);
void axon_trigger_cold_reboot(void);
int64_t axon_uptime_get(void);
uint16_t axon_publish_interval_get(void);
void axon_publish_interval_set(uint16_t publish_interval);
void axon_publish_interval_timer_reset(void);
void axon_publish_interval_callback_set(void (*publish_interval_cb)(void));
int axon_led_0_set_blink(uint32_t delay_on, uint32_t delay_off);
int axon_led_0_set_on(uint8_t brightness);
int axon_led_0_set_off(void);
#if defined(CONFIG_BOARD_AXON_V2_0_NRF52840)
int axon_led_1_set_blink(uint32_t delay_on, uint32_t delay_off);
int axon_led_1_set_on(uint8_t brightness);
int axon_led_1_set_off(void);
#endif

typedef uint8_t hyper_extension_bus_mux_state_t;
void hyper_extension_bus_mux_reset(void);
void hyper_extension_bus_mux_port_select(uint8_t port);
hyper_extension_bus_mux_state_t hyper_extension_bus_mux_state_get(void);
void hyper_extension_bus_mux_state_print(hyper_extension_bus_mux_state_t mux_read);
int axon_init(void);

#endif
```

## src/coap_client.c
```c
/*
 * Copyright (c) 2021 Hyper Collective LTD
 */
#include <zephyr.h>
#include <net/coap_utils.h>
#include <logging/log.h>
#include <net/openthread.h>
#include <net/socket.h>
#include <openthread/thread.h>
#include "coap_client.h"
#ifdef CONFIG_NET_L2_OPENTHREAD
#include "ot_utils.h"
#endif
#include "misc_utils.h"

LOG_MODULE_REGISTER(coap_client, CONFIG_COAP_CLIENT_LOG_LEVEL);

#define CONSOLE_LABEL DT_LABEL(DT_CHOSEN(zephyr_console))

/* Options supported by the server */
static char from_addr_str[INET6_ADDRSTRLEN];
static const char *const coap_uri_path_options[] = {"incoming", "v3", NULL};

void (*on_response_data_handler)(uint8_t *data, uint8_t data_len) = NULL;

/* Variable for storing server address acquiring in provisioning handshake */
static struct sockaddr_in6 unique_local_addr = {
    .sin6_family = AF_INET6,
    .sin6_port = htons(COAP_SERVER_PORT),
    .sin6_addr.s6_addr = {
	0,
    },
    .sin6_scope_id = 0U};

static int coap_post_reply(const struct coap_packet *response,
			   struct coap_reply *reply,
			   const struct sockaddr *from)
{
	int ret = 0;
	const uint8_t *data;
	uint16_t data_len = 0u;
	uint8_t response_code;
	ARG_UNUSED(reply);

	data = coap_packet_get_payload(response, &data_len);

	inet_ntop(AF_INET6, &net_sin6(from)->sin6_addr, from_addr_str,
		  INET6_ADDRSTRLEN);

	response_code = coap_header_get_code(response);
	LOG_INF("Received CoAP response from address %s with code %u.%02d",
		from_addr_str,
		(0b11110000 & response_code) >> 5,
		0b00001111 & response_code);

	switch (response_code)
	{
	case COAP_RESPONSE_CODE_CONTENT:
		if (data_len > 0)
		{
			on_response_data_handler((uint8_t *)data, data_len);
		}
		else
		{
			on_response_data_handler(NULL, 0);
			LOG_INF("No data received!");
		}
		break;

	default:
		if (data_len > 0)
		{
			LOG_INF("CoAP Payload:  datalen: %u data(string):%.*s\n", data_len, (int)data_len, data);
		}
		else
		{
			LOG_INF("No data received!");
		}
	}

	return ret;
}

static int coap_client_post(uint8_t *data, uint8_t len)
{
	if (!inet_pton(AF_INET6, COAP_SERVER, &unique_local_addr.sin6_addr))
	{
		LOG_WRN("error converting address");
		return -1;
	}
	if (unique_local_addr.sin6_addr.s6_addr16[0] == 0)
	{
		LOG_WRN("Peer address not set.");
		return -1;
	}
	LOG_INF("===== CoAP sending hex (size: %u) =====", len);
	hyper_hexdump(data, len);
	LOG_INF("Send 'hyper_data' request to: %s",
		log_strdup(COAP_SERVER));

	int ret = coap_send_request(COAP_METHOD_POST,
				    (const struct sockaddr *)&unique_local_addr,
				    coap_uri_path_options, data, len, coap_post_reply);

	LOG_INF("coap_send_request return: %d", ret);
	return ret;
}

void transport_coap_client_init(void (*on_response_data_handler_cb)(uint8_t *data, uint8_t data_len))
{
	on_response_data_handler = on_response_data_handler_cb;
	coap_init(AF_INET6, NULL);
}

int transport_coap_client_post(uint8_t *data, uint8_t len)
{
	return coap_client_post(data, len);
}
```

## src/coap_client.h
```c
#ifndef __COAP_CLIENT_H__
#define __COAP_CLIENT_H__

/** @brief Initialize CoAP client.
 */
void transport_coap_client_init(void (*on_response_data_handler_cb)(uint8_t *data, uint8_t data_len));

/** @brief Send hyper_data to the CoAP server.
 */
int transport_coap_client_post(uint8_t *data, uint8_t len);

#define BORDER_ROUTER "fdde:ad00:beef::1"
#define BORDER_ROUTER_IPV4 "64:ff9b::10.3.2.1"
#define COAP_SERVER BORDER_ROUTER
#define COAP_SERVER_PORT 5683

#endif
```

## src/controller.c
```c
#include <logging/log.h>
#include "axon.h"
#include "controller.h"
#include "transport.h"
#include "hyper_device_axon.h"
#include "hyper_device_mcu.h"
#ifdef CONFIG_HYPER_DEVICE_HYDROKIT
#include "hyper_device_hydrokit.h"
#endif
#ifdef CONFIG_HYPER_DEVICE_AS_CO2
#include "hyper_device_as_co2.h"
#endif
#ifdef CONFIG_HYPER_DEVICE_AS_HUM
#include "hyper_device_as_hum.h"
#endif
#ifdef CONFIG_HYPER_DEVICE_AS_FLO
#include "hyper_device_as_flo.h"
#endif
#ifdef CONFIG_HYPER_DEVICE_POWERMETER
#include "hyper_device_powermeter.h"
#endif

#include "hyper_device_utils.h"

LOG_MODULE_REGISTER(controller, CONFIG_MAIN_LOG_LEVEL);

static hyper_device_reg_t hyper_extensions_registry[HYPER_EXTENSIONS_REGISTRY_MAX] = {0};

static uint8_t hyper_message_buffer[256] = {0};

static void hyper_controller_message_processor(uint32_t device_class_id,
					       uint8_t device_id[HYPER_DEVICE_ID_LENGTH], uint8_t *data, uint8_t data_len)
{

	// Only decode data if data received.
	if (data_len != 0)
	{
		for (int i = 0; i < HYPER_EXTENSIONS_REGISTRY_MAX; i++)
		{
			if (!memcmp(hyper_extensions_registry[i].device_id, device_id, HYPER_DEVICE_ID_LENGTH))
			{
				if (hyper_extensions_registry[i].set_data != NULL)
				{
					if (hyper_extensions_registry[i].set_data(data, data_len) != HYPER_OK)
					{
						return;
					}
					LOG_HEXDUMP_INF(device_id, 6, "Called callback for:");
					return;
				}
				else
				{
					LOG_HEXDUMP_ERR(device_id, 6, "Called is not set for:");
					return;
				}
			}
		}
		LOG_HEXDUMP_ERR(device_id, 6, "No callback found for:");
	}
}

static void hyper_controller_on_message_handler(uint8_t *data, uint8_t data_len)
{
	if (HYPER_OK !=
	    hyper_msgpack_process_multimessage(hyper_controller_message_processor, data, data_len))
	{
		LOG_ERR("hyper_msgpack_process_multimessage() failed!");
		return;
	}
}

static int hyper_controller_extensions_registry_update()
{
	int ret = 0;

	// reset hyper_extensions_registry after the first (Axon)
	for (int i = 1; i < HYPER_EXTENSIONS_REGISTRY_MAX; i++)
	{
		memset(hyper_extensions_registry[i].device_id, 0,
		       sizeof(hyper_extensions_registry[i].device_id));
		hyper_extensions_registry[i].get_data = NULL;
		hyper_extensions_registry[i].set_data = NULL;
	}

	// detect and init extensions
	hyper_extension_type_t hyper_extension_type = hyper_extension_get_type();
	if (hyper_extension_type == HYPER_EXTENSION_EEPROM)
	{
		uint32_t extension_class_id = 0;
		hyper_extension_class_id_read(&extension_class_id);
#ifdef CONFIG_HYPER_DEVICE_HYDROKIT
		if (hyper_device_hydrokit_is_hydrokit(extension_class_id))
		{
			ret = hyper_device_hydrokit_init(hyper_extensions_registry);
			if (ret)
			{
				LOG_ERR("hyper_device_hydrokit_init() failed with exit code: %d\n", ret);
				return ret;
			}
		}
#endif
#ifdef CONFIG_HYPER_DEVICE_AS_CO2
		else if (hyper_device_as_co2_is_as_co2(extension_class_id))
		{
			ret = hyper_device_as_co2_init(hyper_extensions_registry);
			if (ret)
			{
				LOG_ERR("hyper_device_as_co2_init() failed with exit code: %d\n", ret);
				return ret;
			}
		}
#endif
#ifdef CONFIG_HYPER_DEVICE_AS_HUM
		else if (hyper_device_as_hum_is_as_hum(extension_class_id))
		{
			ret = hyper_device_as_hum_init(hyper_extensions_registry);
			if (ret)
			{
				LOG_ERR("hyper_device_as_hum_init() failed with exit code: %d\n", ret);
				return ret;
			}
		}
#endif
#ifdef CONFIG_HYPER_DEVICE_AS_FLO
		else if (hyper_device_as_flo_is_as_flo(extension_class_id))
		{
			ret = hyper_device_as_flo_init(hyper_extensions_registry);
			if (ret)
			{
				LOG_ERR("hyper_device_as_flo_init() failed with exit code: %d\n", ret);
				return ret;
			}
		}
#endif
#ifdef CONFIG_HYPER_DEVICE_POWERMETER
		else if (hyper_device_powermeter_is_powermeter(extension_class_id))
		{
			ret = hyper_device_powermeter_init(hyper_extensions_registry);
			if (ret)
			{
				LOG_ERR("hyper_device_powermeter_init() failed with exit code: %d\n", ret);
				return ret;
			}
		}
#endif
		else
		{
			LOG_ERR("Extension detection error!");
			ret = 1;
		}
	}
	else if (hyper_extension_type == HYPER_EXTENSION_MCU)
	{
		ret = hyper_device_mcu_init(hyper_extensions_registry);
		if (ret)
		{
			LOG_ERR("hyper_device_mcu_init() failed with exit code: %d\n", ret);
			return ret;
		}
	}
	else
	{
		LOG_INF("No Extension detected!");
		ret = 0;
	}

	return ret;
}

static void hyper_controller_publish()
{
	// detect devices in bus and update registry
	hyper_controller_extensions_registry_update();
	uint8_t total_data_len = 0;
	// publish all extensions in the registry
	for (int i = 0; i < HYPER_EXTENSIONS_REGISTRY_MAX; i++)
	{
		if (hyper_extensions_registry[i].get_data != NULL)
		{
			uint8_t data_len = 0;
			if (hyper_extensions_registry[i].get_data(hyper_message_buffer + total_data_len, &data_len) == HYPER_OK)
			{
				if (data_len > 0)
				{
					total_data_len += data_len;
				}
			}
		}
	}
	transport_publish(hyper_message_buffer, total_data_len);
}

int hyper_controller_init()
{
	int ret = 0;
	// init transport
	ret = transport_init(hyper_controller_on_message_handler);
	if (ret)
	{
		LOG_ERR("transport_init() failed with exit code: %d\n", ret);
		return ret;
	}

	// init axon_publish mechanism
	axon_publish_interval_callback_set(hyper_controller_publish);
	axon_publish_interval_set(AXON_PUBLISH_INTERVAL_DEFAULT_SEC);

	// init hyper axon device
	ret = hyper_device_axon_init(hyper_extensions_registry);
	if (ret)
	{
		LOG_ERR("hyper_device_axon_init() failed with exit code: %d\n", ret);
		return ret;
	}

	// detect and init extensions
	ret = hyper_controller_extensions_registry_update();
	if (ret)
	{
		LOG_ERR("hyper_controller_extensions_registry_update() failed with exit code: %d\n", ret);
		return ret;
	}

	// TODO: init a task that pings the gateway each X minutes, reboots if not reachable

	return ret;
}
```

## src/controller.h
```c
#ifndef __CONTROLLER_H__
#define __CONTROLLER_H__
#include <stdint.h>

int hyper_controller_init(void);

#endif
```

## src/driver_utils.c
```c
#include <zephyr.h>
#include <logging/log.h>
#include <drivers/i2c.h>
#include "driver_utils.h"

LOG_MODULE_REGISTER(driver_utils, CONFIG_COAP_CLIENT_LOG_LEVEL);

int hyper_dev_init(struct device **devc, const char *label)
{
	*devc = (struct device *)device_get_binding(label);

	if (*devc == NULL)
	{
		LOG_ERR("No device \"%s\" found; did initialization fail?", label);
		return 1;
	}
	else
	{
		LOG_INF("Found device \"%s\"", label);
		return 0;
	}
}

#if defined(CONFIG_SOC_SERIES_NRF52X)
static void nrf5_ieee_eui64_read(uint8_t *ieee_eui64)
{
	uint64_t factory_address;
	uint32_t index = 0;
	// By default, the device uses Nordic Semiconductor's MA-L (fa-ce-36). It can be modified by overwriting
	const uint32_t nordic_oui = 0xf4ce36;

	// Set the MAC Address Block Larger (MA-L) formerly called OUI.
	ieee_eui64[index++] = (nordic_oui >> 16) & 0xff;
	ieee_eui64[index++] = (nordic_oui >> 8) & 0xff;
	ieee_eui64[index++] = nordic_oui & 0xff;

	// Use device identifier assigned during the production.
	factory_address = (uint64_t)NRF_FICR->DEVICEID[0] << 32;
	factory_address |= NRF_FICR->DEVICEID[1];
	memcpy(ieee_eui64 + index, &factory_address, sizeof(factory_address) - index);
}
#endif

void hyper_macaddr_get(uint8_t *macaddr)
{
	uint8_t eui64[8];
#if defined(CONFIG_SOC_SERIES_NRF52X)
	nrf5_ieee_eui64_read(eui64);
	// get the last 6 bytes, ignoring the first two bytes of Nordic Semiconductor's MA-L
	memcpy(macaddr, &eui64[2], 6);
#else
#error hyper_macaddress_read unsupported by this target device
#endif
}

bool hyper_i2c_device_is_present(struct device *i2c_dev, uint16_t i2c_addr)
{
	struct i2c_msg msgs[1];
	uint8_t dst;
	/* Send the address to read from */
	msgs[0].buf = &dst;
	msgs[0].len = 0U;
	msgs[0].flags = I2C_MSG_WRITE | I2C_MSG_STOP;
	if (i2c_transfer(i2c_dev, &msgs[0], 1, i2c_addr) == 0)
	{
		return true;
	}
	else
	{
		return false;
	}
}
```

## src/driver_utils.h
```c
#ifndef __DRIVER_UTILS_H__
#define __DRIVER_UTILS_H__

#include <device.h>

int hyper_dev_init(struct device **devc, const char *label);
void hyper_macaddr_get(uint8_t *macaddr);
bool hyper_i2c_device_is_present(struct device *i2c_dev, uint16_t i2c_addr);
#endif
```

## src/hyper_device_utils.c
```c
#include <logging/log.h>
#include <stdio.h>
#include "hyper_device_utils.h"

#include "cmp.h"

LOG_MODULE_REGISTER(hyper_device_data_utils, CONFIG_MAIN_LOG_LEVEL);

typedef struct
{
    uint8_t *buf;
    size_t offset;
} msgpack_t;

static bool msgpack_reader(cmp_ctx_t *ctx, void *data, size_t count)
{
    msgpack_t *msgpack = (msgpack_t *)ctx->buf;
    memcpy(data, msgpack->buf + msgpack->offset, count);
    msgpack->offset += count;
    return true;
}

int hyper_msgpack_extract_device_id(uint8_t *device_id, uint8_t *data, uint8_t data_len)
{
    cmp_ctx_t cmp_ctx = {0};
    uint8_t buffer[data_len];

    memcpy(buffer, data, data_len);
    msgpack_t msgpack = {buffer, 0};

    cmp_init(&cmp_ctx, (void *)&msgpack, msgpack_reader, NULL, NULL);

    uint32_t msg_array_size = 0;

    // Main msg array
    if (!cmp_read_array(&cmp_ctx, &msg_array_size) && msg_array_size != 3)
    {
        LOG_ERR("cmp_read_array() error '%s'!", cmp_strerror(&cmp_ctx));
        return -1;
    }
    printf("hyper_device_decode: msg_array_size=%lu\n", (long unsigned)msg_array_size);

    cmp_object_t obj;
    // Device class id
    if (!cmp_read_object(&cmp_ctx, &obj))
    {
        LOG_ERR("cmp_read_object() error 'could not read object'!");
        return -1;
    }
    uint32_t device_class_id;
    if (!cmp_object_as_uint(&obj, &device_class_id))
    {
        LOG_ERR("cmp_object_as_uint() error 'could not read device_class_id'!");
        return -1;
    }

    // Device id
    uint32_t device_id_size = 0;
    if (!cmp_read_bin_size(&cmp_ctx, &device_id_size))
    {
        LOG_ERR("cmp_read_array() error '%s'!", cmp_strerror(&cmp_ctx));
        return -1;
    }

    if (device_id_size != 6)
    {
        LOG_ERR("cmp_object_as_uint() error 'wrong device_id_size'!");
        return -1;
    }

    memcpy(device_id, data + msgpack.offset, 6);

    return 0;
}

void hyper_extensions_registry_insert(hyper_device_reg_t *reg, uint8_t *device_id,
                                      uint8_t (*get_data)(uint8_t *data),
                                      void (*set_data)(uint8_t *data, uint8_t data_len))
{
    uint8_t zeros[6] = {0};
    for (int i = 0; i < HYPER_EXTENSIONS_REGISTRY_MAX; i++)
    {
        // Add only if empty
        if (!memcmp(reg[i].device_id, zeros, sizeof(reg[i].device_id)))
        {
            // Add only if it doesnt exist yet
            if (memcmp(reg[i].device_id, device_id, sizeof(reg[i].device_id)))
            {
                memcpy(reg[i].device_id, device_id, sizeof(reg[i].device_id));
                reg[i].get_data = get_data;
                reg[i].set_data = set_data;
                LOG_HEXDUMP_DBG(device_id, 6, "device added to hyper_extensions_registry:");
                LOG_DBG("reg[i].get_data: %p\n", reg[i].get_data);
                LOG_DBG("reg[i].set_data: %p\n", reg[i].set_data);
                break;
            }
            else
            {
                LOG_ERR("extension already exists in hyper_extensions_registry, pos: %d\n", i);
                LOG_HEXDUMP_DBG(reg[i].device_id, 6, "reg[i].device_id");
                LOG_HEXDUMP_DBG(device_id, 6, "device_id:");
            }
        }
    }
}
```

## src/hyper_device_utils.h
```c
#ifndef __HYPER_DEVICE_DATA_UTILS_H__
#define __HYPER_DEVICE_DATA_UTILS_H__

#include <stdint.h>

typedef struct
{
    uint8_t device_id[6];
    uint8_t (*get_data)(uint8_t *data);
    void (*set_data)(uint8_t *data, uint8_t data_len);
} hyper_device_reg_t;

#define HYPER_EXTENSIONS_REGISTRY_MAX 5

void hyper_extensions_registry_insert(hyper_device_reg_t *reg, uint8_t *device_id,
                                      uint8_t (*get_data)(uint8_t *data),
                                      void (*set_data)(uint8_t *data, uint8_t data_len));
int hyper_msgpack_extract_device_id(uint8_t *device_id, uint8_t *data, uint8_t data_len);

#endif
```

## src/misc_utils.c
```c
#include <logging/log.h>
#include "misc_utils.h"

LOG_MODULE_REGISTER(misc_utils, CONFIG_MAIN_LOG_LEVEL);

void hyper_hexdump(uint8_t *data, uint8_t len)
{
	LOG_HEXDUMP_DBG(data, len, "");
}
```

## src/misc_utils.h
```c
#ifndef __MISC_UTILS_H__
#define __MISC_UTILS_H__
#include <stdint.h>

void hyper_hexdump(uint8_t *data, uint8_t len);
#define BYTE_TO_BINARY_PATTERN "%c%c%c%c%c%c%c%c"
#define BYTE_TO_BINARY(byte)           \
	(byte & 0x80 ? '1' : '0'),     \
	    (byte & 0x40 ? '1' : '0'), \
	    (byte & 0x20 ? '1' : '0'), \
	    (byte & 0x10 ? '1' : '0'), \
	    (byte & 0x08 ? '1' : '0'), \
	    (byte & 0x04 ? '1' : '0'), \
	    (byte & 0x02 ? '1' : '0'), \
	    (byte & 0x01 ? '1' : '0')

#endif
```

## axon/hyper_device/Kconfig
```kconfig
#
# Copyright (c) 2021 Hyper Collective LTD
#

config HYPER_DEVICE
	bool "hyper-device"
	default y
	depends on I2C
	select LIBCMP

if HYPER_DEVICE
rsource "hyper-device-hydrokit/Kconfig"
rsource "hyper-device-as-co2/Kconfig"
rsource "hyper-device-as-hum/Kconfig"
endif
```

## axon/hyper_device/hyper-device-as-co2/Kconfig
```kconfig
#
# Copyright (c) 2022 Hyper Collective LTD
#

config HYPER_DEVICE_AS_CO2
	bool "hyper-device-as-co2"
	default y
```

## axon/hyper_device/hyper-device-as-flo/Kconfig
```kconfig
#
# Copyright (c) 2022 Hyper Collective LTD
#

config HYPER_DEVICE_AS_FLO
	bool "hyper-device-as-flo"
	default y
```

## axon/hyper_device/hyper-device-as-hum/Kconfig
```kconfig
#
# Copyright (c) 2022 Hyper Collective LTD
#

config HYPER_DEVICE_AS_HUM
	bool "hyper-device-as-hum"
	default y
```

## axon/hyper_device/hyper-device-hydrokit/Kconfig
```kconfig
#
# Copyright (c) 2021 Hyper Collective LTD
#

config HYPER_DEVICE_HYDROKIT
	bool "hyper-device-hydrokit"
	default y
	select MCP342X
```

## axon/hyper_device/hyper-device-powermeter/Kconfig
```kconfig
#
# Copyright (c) 2022 Hyper Collective LTD
#

config HYPER_DEVICE_POWERMETER
	bool "hyper-device-powermeter"
	select MODBUS
	default y
```

## boards/arm/axon_v0_2_nrf52840/Kconfig
```kconfig
# Axon v0.2 board configuration

# Copyright (c) 2021 Hyper Collective LTD
# All rights reserved

config BOARD_ENABLE_DCDC
	bool "Enable DCDC mode"
	select SOC_DCDC_NRF52X
	default y
	depends on BOARD_AXON_V0_2_NRF52840
```

## boards/arm/axon_v0_2_nrf52840/Kconfig.board
```kconfig
# Axon v0.2 board configuration

# Copyright (c) 2021 Hyper Collective LTD
# All rights reserved

config BOARD_AXON_V0_2_NRF52840
	bool "Axon v0.2 nrf52840"
	depends on SOC_NRF52840_QIAA
```

## boards/arm/axon_v0_2_nrf52840/Kconfig.defconfig
```kconfig
# Axon v0.2 board configuration

# Copyright (c) 2021 Hyper Collective LTD
# All rights reserved

if BOARD_AXON_V0_2_NRF52840

config BOARD
	default "axon_v0_2_nrf52840"

config BT_CTLR
	default BT

endif # BOARD_AXON_V0_2_NRF52840
```

## boards/arm/axon_v1_0_nrf52840/Kconfig.defconfig
```kconfig
# Axon v1.0 board configuration

# Copyright (c) 2021 Hyper Collective LTD
# All rights reserved

if BOARD_AXON_V1_0_NRF52840

config BOARD
	default "axon_v1_0_nrf52840"

config BT_CTLR
	default BT

endif # BOARD_AXON_V1_0_NRF52840
```

## boards/arm/axon_v1_3_0_nrf52840/Kconfig
```kconfig
# Axon v1.0 board configuration

# Copyright (c) 2021 Hyper Collective LTD
# All rights reserved

config BOARD_ENABLE_DCDC
	bool "Enable DCDC mode"
	select SOC_DCDC_NRF52X
	default y
	depends on BOARD_AXON_v1_3_0_NRF52840
```

## boards/arm/axon_v1_3_0_nrf52840/axon_v1_3_0_nrf52840_defconfig
```kconfig
# Copyright (c) 2021 Hyper Collective LTD
# All rights reserved

CONFIG_SOC_SERIES_NRF52X=y
CONFIG_SOC_NRF52840_QIAA=y
CONFIG_BOARD_AXON_V1_3_0_NRF52840=y

# Enable MPU
CONFIG_ARM_MPU=y

# Enable hardware stack protection
CONFIG_HW_STACK_PROTECTION=y

# Enable RTT
CONFIG_USE_SEGGER_RTT=y

# enable GPIO
CONFIG_GPIO=y

# enable uart driver
CONFIG_SERIAL=y

# enable console
CONFIG_CONSOLE=y
CONFIG_UART_CONSOLE=y

# additional board options
CONFIG_GPIO_AS_PINRESET=y

# enable builtin sensors
CONFIG_I2C=y
CONFIG_SENSOR=y
CONFIG_SHT3XD=y
CONFIG_VEML7700=y
```

## boards/arm/axon_v2_0_nrf52840/Kconfig.board
```kconfig
# Axon v1.0 board configuration

# Copyright (c) 2021 Hyper Collective LTD
# All rights reserved

config BOARD_AXON_V2_0_NRF52840
	bool "Axon v2.0 nrf52840"
	depends on SOC_NRF52840_QIAA
```

## drivers/Kconfig
```kconfig
menuconfig HYPER_DRIVERS
        bool "Hyper Drivers"
        default y
        help
          Enable support for Hyper Drivers

if HYPER_DRIVERS

module = HYPER_DRIVERS
module-str = HYPER_DRIVERS
source "subsys/logging/Kconfig.template.log_config"

rsource "mcp342x/Kconfig"
rsource "veml7700/Kconfig"

endif
```

## drivers/mcp342x/Kconfig
```kconfig
config MCP342X
	bool "MCP342X ADC chip"
	depends on I2C
	help
	  Enable driver for MCP342X ADC chips.
```

## drivers/veml7700/Kconfig
```kconfig
config VEML7700
	bool "VEML7700 Light Sensor"
	depends on I2C
	help
	  Enable driver for VEML7700 light sensors.
```
